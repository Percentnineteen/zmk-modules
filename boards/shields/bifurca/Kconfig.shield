## boards/shields/bifurca/Kconfig.shield
```kconfig
config SHIELD_BIFURCA_DONGLE
def_bool $(shields_list_contains,bifurca_dongle)

  config SHIELD_BIFURCA_LEFT
def_bool $(shields_list_contains,bifurca_left)

  config SHIELD_BIFURCA_RIGHT
def_bool $(shields_list_contains,bifurca_right)
```

## boards/shields/chirality_tb/Kconfig.shield
```kconfig
# Copyright (c) 2020 Pete Johanson
# SPDX-License-Identifier: MIT

config SHIELD_CHIRALITY_LEFT
	def_bool $(shields_list_contains,chirality_tb_left)

config SHIELD_CHIRALITY_RIGHT
	def_bool $(shields_list_contains,chirality_tb_right)
```
