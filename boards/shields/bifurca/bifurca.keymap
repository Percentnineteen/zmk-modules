#include <behaviors.dtsi>
#include <dt-bindings/zmk/keys.h>
#include <dt-bindings/zmk/bt.h>
#include <dt-bindings/zmk/outputs.h>
#include <behaviors/sponge_lock.dtsi>
#include <dt-bindings/zmk/ext_power.h>
#include "./bifurca.h"
#include "zmk-helpers/helper.h"
#include "zmk-helpers/key-labels/totem.h"
#include "mouse.dtsi"

#define BASE 0
#define NAV 1
#define NUM 2
#define SYM 3
#define MEDIA 4
#define FUN 5
#define MOUSE 6

#define QUICK_TAP_MS 200

#define KEYS_L LT0 LT1 LT2 LT3 LT4 LM0 LM1 LM2 LM3 LM4 LB0 LB1 LB2 LB3 LB4 LB5  // left hand
#define KEYS_R RT0 RT1 RT2 RT3 RT4 RM0 RM1 RM2 RM3 RM4 RB0 RB1 RB2 RB3 RB4 RB5  // right hand
#define THUMBS LH2 LH1 LH0 RH0 RH1 RH2                                          // thumbs

#define MAKE_HRM(NAME, HOLD, TAP, TRIGGER_POS) \
    ZMK_HOLD_TAP(NAME, \
        flavor = "balanced"; \
        tapping-term-ms = <280>; \
        quick-tap-ms = <QUICK_TAP_MS>; \
        require-prior-idle-ms = <150>; \
        bindings = <HOLD>, <TAP>; \
        hold-trigger-key-positions = <TRIGGER_POS>; \
        hold-trigger-on-release; \
    )
MAKE_HRM(hml, &kp, &kp, KEYS_R THUMBS)  // left-hand HRMs
MAKE_HRM(hmr, &kp, &kp, KEYS_L THUMBS)  // right-hand HRMs

ZMK_HOLD_TAP(hm, bindings = <&kp>, <&kp>; \
  flavor = "balanced"; \
  tapping-term-ms = <200>; \
  quick-tap-ms = <QUICK_TAP_MS>;)
ZMK_HOLD_TAP(caps, bindings = <&sponge_lock>, <&caps_word>; \
  flavor = "tap-preferred"; \
  tapping-term-ms = <200>; \
  quick-tap-ms = <125>;)

&lt {
  quick-tap-ms = <200>;
};
&caps_word {
  continue-list = <UNDER MINUS>;
};
&sponge_lock {
  continue-list = <UNDER MINUS SPACE>;
};

ZMK_LAYER(base,
//              ╭─────────────┬─────────────┬─────────────┬─────────────┬─────────────╮ ╭─────────────┬─────────────┬─────────────┬─────────────┬─────────────╮
                  &kp Q         &kp W         &kp E         &kp R         &kp T           &kp Y         &kp U         &kp I         &kp O         &kp P
//              ├─────────────┼─────────────┼─────────────┼─────────────┼─────────────┤ ├─────────────┼─────────────┼─────────────┼─────────────┼─────────────┤
                  &hm LGUI A    &hm LALT S    &hm LCTRL D   &hm LSHFT F   &kp G           &kp H         &hm LSHFT J   &hm RCTRL K   &hm LALT L    &hm LGUI SQT
//╭─────────────┼─────────────┼─────────────┼─────────────┼─────────────┼─────────────┤ ├─────────────┼─────────────┼─────────────┼─────────────┼─────────────┼─────────────╮
    &kp Q         &kp Z         &kp X         &kp C         &kp V         &kp B           &kp N         &kp M         &kp COMMA     &kp DOT       &kp SLASH     &kp P
//╰─────────────┴─────────────┴─────────────┼─────────────┼─────────────┼─────────────┤ ├─────────────┼─────────────┼─────────────┼─────────────┴─────────────┴─────────────╯
                                              &lt MEDIA ESC &lt NAV SPC   &lt MOUSE TAB   &lt SYM RET   &lt NUM BSPC  &lt FUN DEL
//                                          ╰─────────────┴─────────────┴─────────────╯ ╰─────────────┴─────────────┴─────────────╯
)

ZMK_LAYER(nav,
//              ╭─────────────┬─────────────┬─────────────┬─────────────┬─────────────╮ ╭─────────────┬─────────────┬─────────────┬─────────────┬─────────────╮
                  &sys_reset    &trans        &trans        &trans        &trans          &trans        &trans        &trans        &trans        &trans
//              ├─────────────┼─────────────┼─────────────┼─────────────┼─────────────┤ ├─────────────┼─────────────┼─────────────┼─────────────┼─────────────┤
                  &trans        &trans        &trans        &trans        &trans          &kp LEFT      &kp DOWN      &kp UP        &kp RIGHT     &caps A B
//╭─────────────┼─────────────┼─────────────┼─────────────┼─────────────┼─────────────┤ ├─────────────┼─────────────┼─────────────┼─────────────┼─────────────┼─────────────╮
    &sys_reset    &bootloader   &trans        &trans        &trans        &trans          &kp HOME      &kp PG_DN     &kp PG_UP     &kp END       &trans        &trans
//╰─────────────┴─────────────┴─────────────┼─────────────┼─────────────┼─────────────┤ ├─────────────┼─────────────┼─────────────┼─────────────┴─────────────┴─────────────╯
                                              &trans        &trans        &trans          &trans        &trans        &trans
//                                          ╰─────────────┴─────────────┴─────────────╯ ╰─────────────┴─────────────┴─────────────╯
)

ZMK_LAYER(num,
//              ╭─────────────┬─────────────┬─────────────┬─────────────┬─────────────╮ ╭─────────────┬─────────────┬─────────────┬─────────────┬─────────────╮
                  &kp LBKT      &kp NUM_7     &kp NUM_8     &kp NUM_9     &kp RBKT        &trans        &trans        &trans        &trans        &sys_reset
//              ├─────────────┼─────────────┼─────────────┼─────────────┼─────────────┤ ├─────────────┼─────────────┼─────────────┼─────────────┼─────────────┤
                  &kp SEMI      &kp NUM_4     &kp NUM_5     &kp NUM_6     &kp EQL         &trans        &trans        &trans        &trans        &trans
//╭─────────────┼─────────────┼─────────────┼─────────────┼─────────────┼─────────────┤ ├─────────────┼─────────────┼─────────────┼─────────────┼─────────────┼─────────────╮
    &kp LBKT      &kp GRAVE     &kp NUM_1     &kp NUM_2     &kp NUM_3     &kp BSLH        &trans        &trans        &trans        &trans        &bootloader   &trans
//╰─────────────┴─────────────┴─────────────┼─────────────┼─────────────┼─────────────┤ ├─────────────┼─────────────┼─────────────┼─────────────┴─────────────┴─────────────╯
                                              &kp DOT       &kp NUM_0     &kp MINUS       &trans        &trans        &trans
//                                          ╰─────────────┴─────────────┴─────────────╯ ╰─────────────┴─────────────┴─────────────╯
)

ZMK_LAYER(sym,
//              ╭─────────────┬─────────────┬─────────────┬─────────────┬─────────────╮ ╭─────────────┬─────────────┬─────────────┬─────────────┬─────────────╮
                  &kp LBRC      &kp AMPS      &kp ASTRK     &kp LPAR      &kp RBRC        &trans        &trans        &trans        &trans        &trans
//              ├─────────────┼─────────────┼─────────────┼─────────────┼─────────────┤ ├─────────────┼─────────────┼─────────────┼─────────────┼─────────────┤
                  &kp COLON     &kp DLLR      &kp PRCT      &kp CRRT      &kp PLUS        &trans        &trans        &trans        &trans        &trans
//╭─────────────┼─────────────┼─────────────┼─────────────┼─────────────┼─────────────┤ ├─────────────┼─────────────┼─────────────┼─────────────┼─────────────┼─────────────╮
    &kp LBRC      &kp TILDE     &kp EXCL      &kp AT        &kp HASH      &kp PIPE        &trans        &trans        &trans        &trans        &trans        &trans
//╰─────────────┴─────────────┴─────────────┼─────────────┼─────────────┼─────────────┤ ├─────────────┼─────────────┼─────────────┼─────────────┴─────────────┴─────────────╯
                                              &kp LPAR      &kp RPAR      &kp UNDER       &trans        &trans        &trans
//                                          ╰─────────────┴─────────────┴─────────────╯ ╰─────────────┴─────────────┴─────────────╯
)

ZMK_LAYER(media,
//              ╭─────────────┬─────────────┬─────────────┬─────────────┬─────────────╮ ╭─────────────┬─────────────┬─────────────┬─────────────┬─────────────╮
                  &trans        &trans        &trans        &trans        &trans          &trans        &trans        &trans        &trans        &trans
//              ├─────────────┼─────────────┼─────────────┼─────────────┼─────────────┤ ├─────────────┼─────────────┼─────────────┼─────────────┼─────────────┤
                  &trans        &trans        &trans        &trans        &trans          &bt BT_SEL 0  &bt BT_SEL 1  &bt BT_SEL 2  &bt BT_SEL 3  &bt BT_SEL 4
//╭─────────────┼─────────────┼─────────────┼─────────────┼─────────────┼─────────────┤ ├─────────────┼─────────────┼─────────────┼─────────────┼─────────────┼─────────────╮
    &trans        &trans        &trans        &trans        &trans        &trans          &trans        &trans        &trans        &trans        &trans        &trans
//╰─────────────┴─────────────┴─────────────┼─────────────┼─────────────┼─────────────┤ ├─────────────┼─────────────┼─────────────┼─────────────┴─────────────┴─────────────╯
                                              &trans        &trans        &soft_off       &out OUT_TOG  &trans        &bt BT_CLR
//                                          ╰─────────────┴─────────────┴─────────────╯ ╰─────────────┴─────────────┴─────────────╯
)

ZMK_LAYER(fun,
//              ╭─────────────┬─────────────┬─────────────┬─────────────┬─────────────╮ ╭─────────────┬─────────────┬─────────────┬─────────────┬─────────────╮
                  &kp F12       &kp F7        &kp F8        &kp F9        &kp PSCRN       &trans        &trans        &trans        &trans        &trans
//              ├─────────────┼─────────────┼─────────────┼─────────────┼─────────────┤ ├─────────────┼─────────────┼─────────────┼─────────────┼─────────────┤
                  &kp F11       &kp F4        &kp F5        &kp F6        &kp SLCK        &trans        &trans        &trans        &trans        &trans
//╭─────────────┼─────────────┼─────────────┼─────────────┼─────────────┼─────────────┤ ├─────────────┼─────────────┼─────────────┼─────────────┼─────────────┼─────────────╮
    &kp F12       &kp F10       &kp F1        &kp F2        &kp F3        &kp PAUSE_BREAK &trans        &trans        &trans        &trans        &trans        &trans
//╰─────────────┴─────────────┴─────────────┼─────────────┼─────────────┼─────────────┤ ├─────────────┼─────────────┼─────────────┼─────────────┴─────────────┴─────────────╯
                                              &kp K_APP     &kp SPC       &kp TAB         &soft_off    &trans        &trans
//                                          ╰─────────────┴─────────────┴─────────────╯ ╰─────────────┴─────────────┴─────────────╯
)

ZMK_LAYER(mouse,
//              ╭─────────────┬─────────────┬─────────────┬─────────────┬─────────────╮ ╭─────────────┬─────────────┬─────────────┬─────────────┬─────────────╮
                  &trans        &trans        &trans        &trans        &trans          U_WH_L        U_WH_D        U_WH_U        U_WH_R        &trans
//              ├─────────────┼─────────────┼─────────────┼─────────────┼─────────────┤ ├─────────────┼─────────────┼─────────────┼─────────────┼─────────────┤
                  &trans        &trans        &trans        &trans        &trans          U_MS_L        U_MS_D        U_MS_U        U_MS_R        &trans
//╭─────────────┼─────────────┼─────────────┼─────────────┼─────────────┼─────────────┤ ├─────────────┼─────────────┼─────────────┼─────────────┼─────────────┼─────────────╮
    &trans        &trans        &trans        &trans        &trans        &trans          &trans        &trans        &trans        &trans        &trans        &trans
//╰─────────────┴─────────────┴─────────────┼─────────────┼─────────────┼─────────────┤ ├─────────────┼─────────────┼─────────────┼─────────────┴─────────────┴─────────────╯
                                              &trans        &trans        &trans          &mkp LCLK     &mkp MCLK     &mkp RCLK
//                                          ╰─────────────┴─────────────┴─────────────╯ ╰─────────────┴─────────────┴─────────────╯
)
/* vim: set ft=c tw=174: */
